## CMakeLists.txt
```
# SPDX-License-Identifier: Apache-2.0

cmake_minimum_required(VERSION 3.17.0)

set(DTC_OVERLAY_FILE "boards/nrf52dk_nrf52810.overlay")

find_package(Zephyr REQUIRED HINTS $ENV{ZEPHYR_BASE})
project(hello_world)

FILE(GLOB app_sources src/*.c*)
target_sources(app PRIVATE ${app_sources})

target_include_directories(app PRIVATE
    include
    include/Transports)

set_property(TARGET app PROPERTY CXX_STANDARD 17)    
```

## prj.conf
```kconfig
CONFIG_GPIO=y
CONFIG_SPI=y
#CONFIG_SPI_0=y

# choose UART console
CONFIG_UART_CONSOLE=y

# Debug config
CONFIG_LOG=y
CONFIG_LOG_BUFFER_SIZE=512
CONFIG_LOG_DEFAULT_LEVEL=4
# RTT Viewer
CONFIG_USE_SEGGER_RTT=y
CONFIG_LOG_BACKEND_RTT=y
#CONFIG_LOG_BACKEND_RTT_MODE_DROP=y
CONFIG_LOG_PRINTK=y

# BLE
CONFIG_BT=y
#CONFIG_BT_DEBUG_LOG=y
CONFIG_BT_PERIPHERAL=y
CONFIG_BT_DEVICE_NAME="BT832A"
CONFIG_BT_GATT_CLIENT=y
CONFIG_BT_CTLR_PHY_2M=y
CONFIG_BT_HCI_ACL_FLOW_CONTROL=y
CONFIG_BT_ATT_PREPARE_COUNT=2
CONFIG_BT_CONN_TX_MAX=2
CONFIG_BT_L2CAP_TX_BUF_COUNT=2
CONFIG_BT_BUF_ACL_TX_SIZE=247
CONFIG_BT_BUF_ACL_RX_SIZE=247
CONFIG_BT_L2CAP_TX_MTU=247

# C++
CONFIG_CPLUSPLUS=y
CONFIG_LIB_CPLUSPLUS=y
CONFIG_NEWLIB_LIBC=y
```

## boards/nrf52dk_nrf52810.overlay
```dts
/ {

};

&spi0 {
	compatible = "nordic,nrf-spi";
    status = "okay";
	sck-pin = <29>;
	mosi-pin = <25>;
	miso-pin = <28>;
    cs-gpios = <&gpio0 5 GPIO_ACTIVE_LOW>;
};
```

## src/main.c
```c
#include <zephyr.h>
#include <device.h>
#include <devicetree.h>
#include <drivers/gpio.h>

/* 1000 msec = 1 sec */
#define SLEEP_TIME_MS   2000


void main(void)
{
    const struct device *gpio_0_dev;

	bool gpio_is_on = true;
	int ret;

	gpio_0_dev = device_get_binding("GPIO_0");
	if (gpio_0_dev == NULL) {
		return;
	}    

	ret = gpio_pin_configure(gpio_0_dev, 18, GPIO_OUTPUT_ACTIVE);
	if (ret < 0) {
		return;
	}

	while (1) {
        gpio_pin_set(gpio_0_dev, 18, (int)gpio_is_on);
		gpio_is_on = !gpio_is_on;
		k_msleep(SLEEP_TIME_MS);
	}
}
```

## src/main.cpp
```c
#include <zephyr.h>
#include <device.h>
#include <devicetree.h>
#include <drivers/spi.h>
#include <drivers/gpio.h>
#include <logging/log.h>
#include <sys/printk.h>

#include "ADS131M08_zephyr.hpp"

#include "ble_service.hpp"

// Bluetooth part
//#include <bluetooth/bluetooth.h>
//#include <bluetooth/hci.h>
//#include <bluetooth/conn.h>
//#include <bluetooth/uuid.h>
//#include <bluetooth/gatt.h>

#define DATA_READY_GPIO     ((uint8_t)4)
#define DBG_LED             ((uint8_t)13)

LOG_MODULE_REGISTER(main);

/* Static Functions */
static int gpio_init(void);
static void ads131m08_drdy_cb(const struct device *port, struct gpio_callback *cb, gpio_port_pins_t pins);
static void interrupt_workQueue_handler(struct k_work* wrk);
static int activate_irq_on_data_ready(void);


/* Global variables */
const struct device *gpio_0_dev;
struct gpio_callback callback;
struct k_work interrupt_work_item;    ///< interrupt work item
static uint8_t sampleNum = 0;
static uint8_t i = 0;

static uint8_t ble_tx_buff[247] = {0};
//static uint8_t adcRawData[27] = {0};

ADS131M08 adc;

void main(void)
{
    LOG_ERR("This is a error message!");
    LOG_WRN("This is a warning message!");
    LOG_INF("This is a information message!");
    LOG_DBG("This is a debugging message!");
    ble_tx_buff[225] = 0x0D;
    ble_tx_buff[226] = 0x0A;
    int ret = 0;
    uint16_t reg_value = 0;

    ret = gpio_init();
    k_work_init(&interrupt_work_item, interrupt_workQueue_handler);
    if (ret == 0){
        //LOG_INF("GPIOs Int'd!");        
    }

    adc.init(5, 4, 7, 8000000); // cs_pin, drdy_pin, sync_rst_pin, 2MHz SPI bus

    Bluetooth::SetupBLE();

    if(adc.writeReg(ADS131_CLOCK,0xFF1A)){  //< Clock register (page 55 in datasheet)
        //LOG_INF("ADS131_CLOCK register successfully configured");
    } else {
        LOG_ERR("***ERROR: Writing ADS131_CLOCK register.");
    }
    k_msleep(10);
    if(adc.setGain(32)){    //< Gain Setting, 1-128
        //LOG_INF("ADC Gain properly set to 32");
    } else {
        LOG_ERR("***ERROR: Setting ADC gain!");
    }
    k_msleep(10);
    if(adc.writeReg(ADS131_THRSHLD_LSB,0b0000000000001010)){  //< Clock register (page 55 in datasheet)
        //LOG_INF("ADS131_THRSHLD_LSB register successfully configured");
        // adc.writeReg(ADS131_CH0_CFG,0b0000000000000000);
        // adc.writeReg(ADS131_CH1_CFG,0b0000000000000000);
        // adc.writeReg(ADS131_CH2_CFG,0b0000000000000000);
        // adc.writeReg(ADS131_CH3_CFG,0b0000000000000000);
        // adc.writeReg(ADS131_CH4_CFG,0b0000000000000000);
        // adc.writeReg(ADS131_CH5_CFG,0b0000000000000000);
        // adc.writeReg(ADS131_CH6_CFG,0b0000000000000000);
        // adc.writeReg(ADS131_CH7_CFG,0b0000000000000000);
    } else {
        LOG_ERR("***ERROR: Writing ADS131_THRSHLD_LSB register.");
    }
    k_msleep(10);
    reg_value = adc.readReg(ADS131_CLOCK);
    //LOG_INF("ADS131_CLOCK: 0x%X", reg_value);
    k_msleep(10); 
    
    reg_value = adc.readReg(ADS131_GAIN1);
    //LOG_INF("ADS131_GAIN1: 0x%X", reg_value);
    k_msleep(10);

    reg_value = adc.readReg(ADS131_ID);
    //LOG_INF("ADS131_ID: 0x%X", reg_value);
    k_msleep(10);

    reg_value = adc.readReg(ADS131_STATUS);
    //LOG_INF("ADS131_STATUS: 0x%X", reg_value);
    k_msleep(10);

    reg_value = adc.readReg(ADS131_MODE);
    //LOG_INF("ADS131_MODE: 0x%X", reg_value);
    k_msleep(10);
    
    //LOG_INF("Starting in 3...");
    k_msleep(1000);
    //LOG_INF("2...");
    k_msleep(1000);
    //LOG_INF("1...");
    k_msleep(1000);

    activate_irq_on_data_ready();

    //uint8_t adcRawData[adc.nWordsInFrame * adc.nBytesInWord] = {0};       

    while(1){

#if 0        
        if(gpio_pin_get(gpio_0_dev, DATA_READY_GPIO)) {           
            adc.readAllChannels(adcRawData);

            sampleNum++;
            //LOG_INF("Sample: %d", sampleNum);
            if (sampleNum == 100){
                LOG_INF("ADC[0]: %d", ((adcRawData[3] << 16) | (adcRawData[4] << 8) | adcRawData[5]));
            }
        }
        else {
        }        
#endif
    LOG_INF("Hi");
    k_msleep(10000);
    }
}

static int gpio_init(void){
	int ret = 0;

    gpio_0_dev = device_get_binding("GPIO_0");
	if (gpio_0_dev == NULL) {
		LOG_ERR("***ERROR: GPIO device binding!");
        return -1;
	}    
#if 0
    ret += gpio_pin_configure(gpio_0_dev, DATA_READY_GPIO, GPIO_INPUT | GPIO_PULL_UP);
    ret += gpio_pin_interrupt_configure(gpio_0_dev, DATA_READY_GPIO, GPIO_INT_EDGE_FALLING);
    gpio_init_callback(&callback, ads131m08_drdy_cb, BIT(DATA_READY_GPIO));    
    ret += gpio_add_callback(gpio_0_dev, &callback);
    if (ret != 0){
        LOG_ERR("***ERROR: GPIO initialization\n");
    }
#endif

    //ret = gpio_pin_configure(gpio_0_dev, DATA_READY_GPIO, GPIO_INPUT | GPIO_ACTIVE_LOW);
    
    ret = gpio_pin_configure(gpio_0_dev, DBG_LED, GPIO_OUTPUT_ACTIVE); // Set SYNC/RESET pin to HIGH
   
    gpio_pin_set(gpio_0_dev, DBG_LED, 0);
    LOG_INF("Entering sleep...");
    k_sleep(K_MSEC(1000)); // give some time to ADS131 to settle after power on
    LOG_INF("Waking up...");
    gpio_pin_set(gpio_0_dev, DBG_LED, 1);


    return ret;
}

static int activate_irq_on_data_ready(void){
    int ret = 0;

    ret += gpio_pin_configure(gpio_0_dev, DATA_READY_GPIO, GPIO_INPUT | GPIO_PULL_UP);
    ret += gpio_pin_interrupt_configure(gpio_0_dev, DATA_READY_GPIO, GPIO_INT_EDGE_FALLING);
    gpio_init_callback(&callback, ads131m08_drdy_cb, BIT(DATA_READY_GPIO));    
    ret += gpio_add_callback(gpio_0_dev, &callback);
    if (ret != 0){
        LOG_ERR("***ERROR: GPIO initialization\n");
    } else {
        LOG_INF("Data Ready Int'd!");
    } 

    return ret;
}

static void ads131m08_drdy_cb(const struct device *port, struct gpio_callback *cb, gpio_port_pins_t pins){
    k_work_submit(&interrupt_work_item); 
}

/**
 * @brief IntWorkQueue handler. Used to process interrupts coming from ADS131M08 Data Ready interrupt pin 
 * Because all activity is performed on cooperative level no addition protection against data corruption is required
 * @param wrk work object
 * @warning  Called by system scheduled in cooperative level.
 */
static void interrupt_workQueue_handler(struct k_work* wrk)
{	
    uint8_t adcBuffer[(adc.nWordsInFrame * adc.nBytesInWord)] = {0};
    adc.readAllChannels(adcBuffer);
    
    ble_tx_buff[25*i + 24] = sampleNum;
    memcpy((ble_tx_buff + 25*i), (adcBuffer + 3), 24);

    sampleNum++;
    i++;
    if(i == 9){
        i = 0;
        Bluetooth::SensorNotify(ble_tx_buff, 227);
    }

}
```

## include/ADS131M08_zephyr.hpp
```c
#pragma once

#include <zephyr/types.h>
#include <device.h>
#include <drivers/gpio.h>
#include <drivers/spi.h>
#include <sys/util.h>
#include <atomic>

#define ADS131_ID 0x00
#define ADS131_STATUS 0x01
#define ADS131_MODE 0x02
#define ADS131_CLOCK 0x03
#define ADS131_GAIN1 0x04
#define ADS131_GAIN2 0x05
#define ADS131_CFG 0x06
#define ADS131_THRSHLD_MSB 0x07
#define ADS131_THRSHLD_LSB 0x08

#define ADS131_CH0_CFG 0x09
#define ADS131_CH0_OCAL_MSB 0x0A
#define ADS131_CH0_OCAL_LSB 0x0B
#define ADS131_CH0_GCAL_MSB 0x0C
#define ADS131_CH0_GCAL_LSB 0x0D
#define ADS131_CH1_CFG 0x0E
#define ADS131_CH1_OCAL_MSB 0x0F
#define ADS131_CH1_OCAL_LSB 0x10
#define ADS131_CH1_GCAL_MSB 0x11
#define ADS131_CH1_GCAL_LSB 0x12
#define ADS131_CH2_CFG 0x13
#define ADS131_CH2_OCAL_MSB 0x14
#define ADS131_CH2_OCAL_LSB 0x15
#define ADS131_CH2_GCAL_MSB 0x16
#define ADS131_CH2_GCAL_LSB 0x17
#define ADS131_CH3_CFG 0x18
#define ADS131_CH3_OCAL_MSB 0x19
#define ADS131_CH3_OCAL_LSB 0x1A
#define ADS131_CH3_GCAL_MSB 0x1B
#define ADS131_CH3_GCAL_LSB 0x1C
#define ADS131_CH4_CFG 0x1D
#define ADS131_CH4_OCAL_MSB 0x1E
#define ADS131_CH4_OCAL_LSB 0x1F
#define ADS131_CH4_GCAL_MSB 0x20
#define ADS131_CH4_GCAL_LSB 0x21
#define ADS131_CH5_CFG 0x22
#define ADS131_CH5_OCAL_MSB 0x23
#define ADS131_CH5_OCAL_LSB 0x24
#define ADS131_CH5_GCAL_MSB 0x25
#define ADS131_CH5_GCAL_LSB 0x26
#define ADS131_CH6_CFG 0x27
#define ADS131_CH6_OCAL_MSB 0x28
#define ADS131_CH6_OCAL_LSB 0x29
#define ADS131_CH6_GCAL_MSB 0x2A
#define ADS131_CH6_GCAL_LSB 0x2B
#define ADS131_CH7_CFG 0x2C
#define ADS131_CH7_OCAL_MSB 0x2D
#define ADS131_CH7_OCAL_LSB 0x2E
#define ADS131_CH7_GCAL_MSB 0x2F
#define ADS131_CH7_GCAL_LSB 0x30


#define ADS131_REGMAP_CRC 0x3E
#define ADS131_RESERVED 0x3F

#define ADS131_READ 0x0A
#define ADS131_WRITE 0x06

class ADS131M08 {
    public:

    //SPIClass * spi = NULL; // SPISettings(spiClk, MSBFIRST, SPI_MODE1)
    int CS, XTAL, DRDY;
    int SpiClk;
    bool firstRead = true;
    uint8_t nWordsInFrame = 10; //< Normal frame contains 10 Words 
    uint8_t nBytesInWord = 3;   //< 24-bit Word by default
    // Dummy word frame to write ADC during ADC data reads
    
    ADS131M08();
    void init(uint8_t cs_pin, uint8_t drdy_pin, uint8_t sync_rst_pin, uint32_t spi_frequency);
    uint16_t readReg(uint8_t reg);
    bool writeReg(uint8_t reg, uint16_t data);
    bool setGain(uint8_t gain);

#if 0    
    void readChannels(int8_t * channelArrPtr, int8_t channelArrLen, int32_t * outputArrPtr);
    void readAllChannels(int32_t inputArr[8]);
    int32_t readChannelSingle(int8_t channel);
    bool globalChop(bool enabled, uint8_t log2delay);
    bool writeReg(uint8_t reg, uint16_t data);
    uint16_t readReg(uint8_t reg);
    bool setGain(int gain);
    uint32_t spiTransferWord(uint16_t inputData = 0x0000);
    void spiCommFrame(uint32_t * outPtr, uint16_t command = 0x0000);
    int32_t twoCompDeco(uint32_t data);
#endif

private:
    //uint32_t spiTransferWord(uint16_t inputData = 0x0000);
    void spiCommandFrame(uint8_t frame_size, uint8_t *cmdFrame);
    uint16_t spiResponseFrame(uint8_t frame_size);
    
    //void ads131m08_drdy_cb(const struct device *port, struct gpio_callback *cb, gpio_port_pins_t pins);           ///< Callback function to call when data ready 
    std::atomic<int> deviceStatus = 0;  ///< SPI Device status
    const device *spiDevice = nullptr;  ///< Logical SPI device
    const device *gpioDevice = nullptr; ///< Device for GPIOs (DRDY and SYNC/RESET)
    struct gpio_callback callback;      ///< 
    struct spi_cs_control csConfig;     ///< Chip select config
    struct spi_config spiConfig;        ///< SPI transport config
};


#if 0
#ifndef ADS131M08_H
#define ADS131M08_H
//ADS131M08.cpp LGPL 
//Adapted for the 8 channel device from https://github.com/icl-rocketry/ADS131M04-Lib (LGPL)


/* Definitions of all the addresses of the registers of the ADS131M04
   Chip. For the content of the registers, please refer to the datasheet:

   https://www.ti.com/lit/gpn/ads131m04

   Written by Imperial College London Rocketry
   Electronics subteam
*/

#include <zephyr/types.h>
#include <device.h>
#include <drivers/gpio.h>
#include <drivers/spi.h>
#include <sys/util.h>

#define ADS131_ID 0x00
#define ADS131_STATUS 0x01
#define ADS131_MODE 0x02
#define ADS131_CLOCK 0x03
#define ADS131_GAIN1 0x04
#define ADS131_GAIN2 0x05
#define ADS131_CFG 0x06
#define ADS131_THRSHLD_MSB 0x07
#define ADS131_THRSHLD_LSB 0x08

#define ADS131_CH0_CFG 0x09
#define ADS131_CH0_OCAL_MSB 0x0A
#define ADS131_CH0_OCAL_LSB 0x0B
#define ADS131_CH0_GCAL_MSB 0x0C
#define ADS131_CH0_GCAL_LSB 0x0D
#define ADS131_CH1_CFG 0x0E
#define ADS131_CH1_OCAL_MSB 0x0F
#define ADS131_CH1_OCAL_LSB 0x10
#define ADS131_CH1_GCAL_MSB 0x11
#define ADS131_CH1_GCAL_LSB 0x12
#define ADS131_CH2_CFG 0x13
#define ADS131_CH2_OCAL_MSB 0x14
#define ADS131_CH2_OCAL_LSB 0x15
#define ADS131_CH2_GCAL_MSB 0x16
#define ADS131_CH2_GCAL_LSB 0x17
#define ADS131_CH3_CFG 0x18
#define ADS131_CH3_OCAL_MSB 0x19
#define ADS131_CH3_OCAL_LSB 0x1A
#define ADS131_CH3_GCAL_MSB 0x1B
#define ADS131_CH3_GCAL_LSB 0x1C
#define ADS131_CH4_CFG 0x1D
#define ADS131_CH4_OCAL_MSB 0x1E
#define ADS131_CH4_OCAL_LSB 0x1F
#define ADS131_CH4_GCAL_MSB 0x20
#define ADS131_CH4_GCAL_LSB 0x21
#define ADS131_CH5_CFG 0x22
#define ADS131_CH5_OCAL_MSB 0x23
#define ADS131_CH5_OCAL_LSB 0x24
#define ADS131_CH5_GCAL_MSB 0x25
#define ADS131_CH5_GCAL_LSB 0x26
#define ADS131_CH6_CFG 0x27
#define ADS131_CH6_OCAL_MSB 0x28
#define ADS131_CH6_OCAL_LSB 0x29
#define ADS131_CH6_GCAL_MSB 0x2A
#define ADS131_CH6_GCAL_LSB 0x2B
#define ADS131_CH7_CFG 0x2C
#define ADS131_CH7_OCAL_MSB 0x2D
#define ADS131_CH7_OCAL_LSB 0x2E
#define ADS131_CH7_GCAL_MSB 0x2F
#define ADS131_CH7_GCAL_LSB 0x30


#define ADS131_REGMAP_CRC 0x3E
#define ADS131_RESERVED 0x3F

#define ADS131_READ 0x0A
#define ADS131_WRITE 0x06


class ADS131M08 {
    public:

    SPIClass * spi = NULL; // SPISettings(spiClk, MSBFIRST, SPI_MODE1)
    int CS, XTAL, DRDY;
    int SpiClk;
    bool firstRead = true;
    int nFrameWords = 10;
    // Dummy word frame to write ADC during ADC data reads
    
    //arduino
    ADS131M08(int cs=5, int xtal=22, int drdy=21, int clk = 2000000);
    void init(int clkin = 8192000);
    void readChannels(int8_t * channelArrPtr, int8_t channelArrLen, int32_t * outputArrPtr);
    void readAllChannels(int32_t inputArr[8]);
    int32_t readChannelSingle(int8_t channel);
    bool globalChop(bool enabled, uint8_t log2delay);
    bool writeReg(uint8_t reg, uint16_t data);
    uint16_t readReg(uint8_t reg);
    bool setGain(int gain);
    uint32_t spiTransferWord(uint16_t inputData = 0x0000);
    void spiCommFrame(uint32_t * outPtr, uint16_t command = 0x0000);
    int32_t twoCompDeco(uint32_t data);
    
    //zephyr
    struct device *dev;
    struct spi_dt_spec spi;
    struct gpio_dt_spec interrupt;
};

#endif

#endif
```

## src/ADS131M08_zephyr.cpp
```c
#include <zephyr.h>
#include <string.h>
#include <init.h>
#include <drivers/gpio.h>
#include <sys/printk.h>
//#include <sys/__assert.h>
#include <stdlib.h>
#include <drivers/spi.h>
#include <logging/log.h>

#include "ADS131M08_zephyr.hpp"

LOG_MODULE_REGISTER(ads131m08);

ADS131M08::ADS131M08() {

    LOG_INF("ADS131M08 Constructor!");
    // CS = cs; XTAL = xtal; DRDY = drdy; //You don't have to use DRDY, can also read off the ADS131_STATUS register.
    // SpiClk = clk;
}

void ADS131M08::init(uint8_t cs_pin, uint8_t drdy_pin, uint8_t sync_rst_pin, uint32_t spi_frequency) {

    LOG_INF("Starting ADS131M08 Initialization...");
    int ret = 0;

/* Configure DRDY and SYNC/RESET GPIOs */
    gpioDevice = device_get_binding("GPIO_0");
    if(gpioDevice == nullptr){
        deviceStatus.store(-1, std::memory_order_relaxed);
        LOG_ERR("***ERROR: Not able to properly bind GPIO_0 device!");
    }

    ret = gpio_pin_configure(gpioDevice, sync_rst_pin, GPIO_OUTPUT_ACTIVE); // Set SYNC/RESET pin to HIGH
    //ret += gpio_pin_configure(gpioDevice, drdy_pin, GPIO_INPUT | GPIO_PULL_UP);
    //ret += gpio_pin_interrupt_configure(gpioDevice, drdy_pin, GPIO_INT_EDGE_FALLING);
    //gpio_init_callback(&callback, ads131m08_drdy_cb, BIT(drdy_pin));    
    //ret += gpio_add_callback(gpioDevice, &callback);
    if (ret != 0){
        LOG_ERR("***ERROR: GPIO initialization\n");
    } 
    
    gpio_pin_set(gpioDevice, sync_rst_pin, 0);
    k_sleep(K_MSEC(20)); // give some time to ADS131 to settle after power on
    gpio_pin_set(gpioDevice, sync_rst_pin, 1);

    // Try to bind chip select device
    csConfig.gpio_dev = device_get_binding("GPIO_0");
    csConfig.delay = 0;
    csConfig.gpio_pin = cs_pin;
    csConfig.gpio_dt_flags = GPIO_ACTIVE_LOW;

    // Bind SPI device only if chip select device successfully binded
    if (csConfig.gpio_dev)
    {
        spiConfig.frequency = spi_frequency;
        spiConfig.operation = SPI_MODE_CPHA | SPI_WORD_SET(8); //< Default Word Size of ADS131M08 is 24
        spiConfig.slave = 0;
        spiConfig.cs = &csConfig;

        spiDevice = device_get_binding("SPI_0");
    }

    if (spiDevice == nullptr)
    {
        deviceStatus.store(-1, std::memory_order_relaxed);
        LOG_ERR("***ERROR: Not able to properly initialize SPI device");
    } else {
        LOG_INF("SPI bus Int'd!");
    }    
    
}

//void ADS131M08::ads131m08_drdy_cb(const struct device *port, struct gpio_callback *cb, gpio_port_pins_t pins){
//    LOG_INF("Data READY!");
//}

uint16_t ADS131M08::readReg(uint8_t reg) {
    /* Reads the content of single register found at address reg
        Returns register value
    */   
    uint8_t commandPref = 0x0A;

    // Make command word using syntax found in data sheet
    uint16_t commandWord = (commandPref << 12) + (reg << 7);

    uint8_t cmdFrame[nWordsInFrame*nBytesInWord] = {0};
    cmdFrame[0] = commandWord >> 8;
    cmdFrame[1] = (uint8_t)(commandWord & 0xFF);

/* Send Command Frame */
    spiCommandFrame(nWordsInFrame*nBytesInWord, cmdFrame);
    k_msleep(1);
/* Read Response */
    return spiResponseFrame(3);    
}

void ADS131M08::spiCommandFrame(uint8_t frame_size, uint8_t *cmdFrame) {

    if (spiDevice != nullptr)
    {
        int status;
        const struct spi_buf txBuffers[] = {
            {
                .buf = cmdFrame,
                .len = frame_size,
            },
        };
        const struct spi_buf rxBuffers[] = {
            {
                .buf = NULL,
                .len = frame_size,
            },
        };
        const struct spi_buf_set txSet = {
            .buffers = txBuffers,
            .count = sizeof(txBuffers) / sizeof(spi_buf),
        };
        const struct spi_buf_set rxSet = {
            .buffers = rxBuffers,
            .count = sizeof(rxBuffers) / sizeof(spi_buf),
        };

        status = spi_transceive(spiDevice, &spiConfig, &txSet, &rxSet);

        deviceStatus.store(status, std::memory_order_relaxed);
    }
}

uint16_t ADS131M08::spiResponseFrame(uint8_t frame_size) {
    uint16_t value = 0;
    uint8_t resp_buffer[2] = {0};

    if (spiDevice != nullptr)
    {
        int status;
        const struct spi_buf txBuffers[] = {
            {
                .buf = NULL,
                .len = frame_size,
            },
        };
        const struct spi_buf rxBuffers[] = {
            {
                .buf = resp_buffer,
                .len = 2,
            },
            {
                .buf = NULL,
                .len = (frame_size - 2),
            },
        };
        const struct spi_buf_set txSet = {
            .buffers = txBuffers,
            .count = sizeof(txBuffers) / sizeof(spi_buf),
        };
        const struct spi_buf_set rxSet = {
            .buffers = rxBuffers,
            .count = sizeof(rxBuffers) / sizeof(spi_buf),
        };

        status = spi_transceive(spiDevice, &spiConfig, &txSet, &rxSet);

        deviceStatus.store(status, std::memory_order_relaxed);
    }
    return (resp_buffer[0] << 8) | resp_buffer[1];
}

bool ADS131M08::writeReg(uint8_t reg, uint16_t data) {
    /* Writes the content of data to the register reg
        Returns true if successful
    */
    uint16_t writeResponse = 0;
    uint8_t commandPref = 0x06;

    // Make command word using syntax found in data sheet
    uint16_t commandWord = (commandPref<<12) + (reg<<7);

    uint8_t cmdFrame[9] = {0}; //< We write only WREG command and one Register data in this Frame
    cmdFrame[0] = commandWord >> 8;
    cmdFrame[1] = (uint8_t)(commandWord & 0xFF);
    cmdFrame[3] = data >> 8;
    cmdFrame[4] = (uint8_t)(data & 0xFF);

/* Send Command Frame */
    spiCommandFrame(9, cmdFrame);
    k_msleep(10);
/* Read Response */
    writeResponse = spiResponseFrame(3);
    //LOG_INF("WriteReg response: 0x%X", writeResponse);

    if ( ( (0x04<<12) + (reg<<7) ) == writeResponse) {
        return true;
    } else {
        return false;
    }
}

bool ADS131M08::setGain(uint8_t gain) { // apply gain to all channels (1 to 128, base 2 (1,2,4,8,16,32,64,128))
    uint16_t writeGain = 0;
    
    switch(gain){
        case 1:
            writeGain = 0x0000;
            break;
        case 2:
            writeGain = 0x1111;
            break;        
        case 4:
            writeGain = 0x2222;
            break; 
        case 8:
            writeGain = 0x3333;
            break;                                
        case 16:
            writeGain = 0x4444;
            break;             
        case 32:
            writeGain = 0x5555;
            break;             
        case 64:
            writeGain = 0x6666;
            break;             
        case 128:
            writeGain = 0x7777;
            break;             
        default:
            writeGain = 0x0000;
            break;
    }

    if(writeReg(ADS131_GAIN1, writeGain)){
        k_msleep(10);
        if(writeReg(ADS131_GAIN2, writeGain)){
            return true;
        }else{
            return false;
        }                
    }else {
        return false;
    }
}

#if 0
#include "ADS131M08.hpp"

#include <kernel.h>
#include <string.h>
#include <drivers/sensor.h>
#include <init.h>
#include <drivers/gpio.h>
#include <sys/printk.h>
#include <sys/__assert.h>
#include <stdlib.h>
#include <drivers/spi.h>
#include <logging/log.h>

ADS131M08::ADS131M08(int cs, int xtal, int drdy, int clk) {

    // CS = cs; XTAL = xtal; DRDY = drdy; //You don't have to use DRDY, can also read off the ADS131_STATUS register.
    // SpiClk = clk;
}

void ADS131M08::init(const struct device *dev) {

    Serial.println("Setting pin configuration");

    device = dev; //set device config
        
    // pinMode(CS, OUTPUT); digitalWrite(CS, HIGH);
    // pinMode(DRDY, INPUT_PULLUP);
    
    // spi->begin();

    // Serial.println("Setting oscillator");

    // ledcSetup(2, clkin, 2);
    // ledcAttachPin(XTAL, 2); //Simulate 8.192Mhz crystal with PWM. This needs to be started as soon as possible after powering on
    // ledcWrite(2,2);

    Serial.println("SPI Ready...");

}

void ADS131M08::readChannels(int8_t * channelArrPtr, int8_t channelArrLen, int32_t * outputArrPtr) {
    
    uint32_t rawDataArr[10];

    // Get data
    spiCommFrame(&rawDataArr[0]);
    
    // Save the decoded data for each of the channels
    for (int8_t i = 0; i<channelArrLen; i++) {
        *outputArrPtr = twoCompDeco(rawDataArr[*channelArrPtr+1]);
        outputArrPtr++;
        channelArrPtr++;
    }
    
}

void ADS131M08::readAllChannels(int32_t inputArr[8]) {
    uint32_t rawDataArr[10];
    int8_t channelArrPtr = 0;
    int8_t channelArrLen = 8;

    // Get data
    spiCommFrame(&rawDataArr[0]);
    // Save the decoded data for each of the channels
    for (int8_t i = 0; i<8; i++) {
        inputArr[i] = twoCompDeco(rawDataArr[channelArrPtr+1]);
        channelArrPtr++;
    }
}

int32_t ADS131M08::readChannelSingle(int8_t channel) {
    /* Returns raw value from a single channel
        channel input from 0-7
    */
    
    int32_t outputArr[1];
    int8_t channelArr[1] = {channel};

    readChannels(&channelArr[0], 1, &outputArr[0]);

    return outputArr[0];
}

bool ADS131M08::globalChop(bool enabled, uint8_t log2delay) {
    /* Function to configure global chop mode for the ADS131M04.

        INPUTS:
        enabled - Whether to enable global-chop mode.
        log2delay   - Base 2 log of the desired delay in modulator clocks periods
        before measurment begins
        Possible values are between and including 1 and 16, to give delays
        between 2 and 65536 clock periods respectively
        For more information, refer to the datasheet.

        Returns true if settings were written succesfully.
    */

    uint8_t delayRegData = log2delay - 1;

    // Get current settings for current detect mode from the CFG register
    uint16_t currentDetSett = (readReg(ADS131_CFG) << 8) >>8;
    
    uint16_t newRegData = (delayRegData << 12) + (enabled << 8) + currentDetSett;

    return writeReg(ADS131_CFG, newRegData);
}

uint32_t ADS131M08::writeReg(uint8_t reg, uint16_t data) {
    uint8_t cmd = 0x06;
    uint16_t cmdWord = (cmd << 12) + (reg << 7);

    //write CS LOW
    //begin transaction

    spiTransferWord(cmdWord);
    spiTransferWord(data);

    //send 4 empty words
    for(uint8_t i=0; i<4; i++) {
        spiTransferWord();
    }

    //end transaction
    //write CS HIGH

    //get response
    uint32_t responseArr[10];
    spiCommFrame(&responseArr[0]);

    if ( ( (0x04<<12) + (reg<<7) ) == responseArr[0]) {
        return true;
    } else {
        return false;
    }
}

uint32_t ADS131M08::readReg(uint8_t reg) {
    uint8_t cmd = 0x0A;
    uint16_t cmdWord = (cmd << 12) + (reg << 7);

    uint32_t responseArr[10];

    //send command
    spiCommFrame(&responseArr[0], cmdWord);

    //read response
    spiCommFrame(&responseArr[0]);

    return responseArr[0] >> 16;
}

uint32_t ADS131M08::spiTransferWord(uint16_t bytes) {
    const struct spi_buf buf[2] = { 
        {
            .buf = bytes,
            .len = 2
        }, 
        {
            .buf = 0x00,
            .len = 1
        }
    };
    const struct spi_buf_set tx = {
        .buffers = buf
    };

    const struct spi_buf_set rx = {
        { 
            .buf = 0x000000,
            .len = 3
        }
    }

    spi_transceive_dt(&device->config, &tx, &rx);
    
}

uint16_t ADS131M08::spiCommFrame(uint32_t *outPtr, uint16_t cmd) {
    //write CS LOW
    //begin transaction

    *outPtr = spiTransferWord(cmd);

    // For the next 8 words, just read the data
    for(uint8_t i=1; i<9; i++) {    
        outPtr++;
        *outPtr = spiTransferWord() >> 8;
    }   

    //save CRC bits
    outPtr++;
    *outPtr = spiTransferWord();

    //end transaction
    //write CS high

}


// bool ADS131M08::writeReg(uint8_t reg, uint16_t data) {
//     /* Writes the content of data to the register reg
//         Returns true if successful
//     */
    
//     uint8_t commandPref = 0x06;

//     // Make command word using syntax found in data sheet
//     uint16_t commandWord = (commandPref<<12) + (reg<<7);

//     digitalWrite(CS, LOW);
//     spi->beginTransaction(SPISettings(SpiClk, MSBFIRST, SPI_MODE1));

//     spiTransferWord(commandWord);
    
//     spiTransferWord(data);

//     // Send 4 empty words
 
//     for (uint8_t i=0; i<4; i++) {
//         spiTransferWord();
//     }

//     spi->endTransaction();
//     digitalWrite(CS, HIGH);

//     // Get response
//     uint32_t responseArr[10];
//     spiCommFrame(&responseArr[0]);

//     if ( ( (0x04<<12) + (reg<<7) ) == responseArr[0]) {
//         return true;
//     } else {
//         return false;
//     }
// }

// uint16_t ADS131M08::readReg(uint8_t reg) {
//     /* Reads the content of single register found at address reg
//         Returns register value
//     */
    
//     uint8_t commandPref = 0x0A;

//     // Make command word using syntax found in data sheet
//     uint16_t commandWord = (commandPref << 12) + (reg << 7);

//     uint32_t responseArr[10];
//     // Use first frame to send command
//     spiCommFrame(&responseArr[0], commandWord);

//     // Read response
//     spiCommFrame(&responseArr[0]);

//     return responseArr[0] >> 16;
// }

// uint32_t ADS131M08::spiTransferWord(uint16_t inputData) {
//     /* Transfer a 24 bit word
//         Data returned is MSB aligned
//     */ 

//     uint32_t data = spi->transfer(inputData >> 8);
//     data <<= 8;
//     data |= spi->transfer((inputData<<8) >> 8);
//     data <<= 8;
//     data |= spi->transfer(0x00);

//     return data << 8;
// }

// void ADS131M08::spiCommFrame(uint32_t * outPtr, uint16_t command) {
//     // Saves all the data of a communication frame to an array with pointer outPtr


//     /*
//     spi_write(device *dev, spi_config *config, spi_bf_set *tx_bufs)
//     spi_read(device *dev, spi_config *config, spi_buf_set *rx_bufs)
    
//     there are _async functions with struct k_poll_signal *async as the end argument
    
//     spi_release(device *dev, spi_config *config)

//     */

//     digitalWrite(CS, LOW);

//     spi->beginTransaction(SPISettings(SpiClk, MSBFIRST, SPI_MODE1));

//     // Send the command in the first word
//     *outPtr = spiTransferWord(command);

//     // For the next 8 words, just read the data
//     for (uint8_t i=1; i < 9; i++) {
//         outPtr++;
//         *outPtr = spiTransferWord() >> 8;
//     }

//     // Save CRC bits
//     outPtr++;
//     *outPtr = spiTransferWord();

//     spi->endTransaction();

//     digitalWrite(CS, HIGH);
// }

int32_t ADS131M08::twoCompDeco(uint32_t data) {
    // Take the two's complement of the data

    data <<= 8;
    int32_t dataInt = (int)data;

    return dataInt/pow(2,8);
}

bool ADS131M08::setGain(int gain) { // apply gain to all channels (1 to 128, base 2 (1,2,4,8,16,32,64,128))
    uint16_t writegain = 0;
    if(gain == 1 ) {
        writegain = 0b0000000000000000;
    }  
    else if (gain == 2) {
        writegain = 0b0001000100010001;
    }
    else if (gain == 4) {
        writegain = 0b0010001000100010;
    }
    else if (gain == 8) { 
        writegain = 0b0011001100110011;
    }
    else if (gain == 16) { 
        writegain = 0b0100010001000100;
    }
    else if (gain == 32) {
        writegain = 0b0101010101010101;
    }
    else if (gain == 64) {
        writegain = 0b0110011001100110;
    }
    else if (gain == 128) {
        writegain = 0b0111011101110111;
    }
    else {
        return false;
    }
    writeReg(ADS131_GAIN1, writegain);
    writeReg(ADS131_GAIN2, writegain);

    return true;
}

#endif
```

## src/ble_service.cpp
```c
#include <zephyr.h>

#include <bluetooth/bluetooth.h>
#include <bluetooth/conn.h>
#include <logging/log.h>
#include <sys/atomic.h>

#include "ble_gatt.hpp"
#include "ble_service.hpp"


LOG_MODULE_REGISTER(bluetooth);

namespace
{

constexpr static uint16_t connectionIntervalMin = 6; ///< Minimal connection interval in 1.25 milliseconds intervals
constexpr static uint16_t connectionIntervalMax = 8; ///< Maximum connection interval in 1.25 milliseconds intervals
constexpr static uint16_t connectionLatency = 0;     ///< Connection latancy
constexpr static uint16_t connectionTimeout = 400;   ///< Connection timeout in 10 msec intervals

//Bluetooth::Gatt::BleOutputWorker worker;   ///< Ble output characteristic worker
bt_conn *activeConnection = nullptr;       ///< Active connection

/**
 * @brief Callback called when MTU paramter is updated with bt_gatt_exchange_mtu() function
 */
void exchange_func(struct bt_conn *conn, uint8_t err, struct bt_gatt_exchange_params *params)
 {
    struct bt_conn_info info = {0};

    printk("MTU exchange %s\n", err == 0 ? "successful" : "failed");
    err = bt_conn_get_info(conn, &info);

    if (info.role == BT_CONN_ROLE_MASTER) {

    }
}

/**
 * @brief Callback called when new client is connected
 * 
 * @param connected connected bluetooth connection
 * @param err connection error
 */
void OnClientConnected(bt_conn *connected, uint8_t err)
{
    if (err)
    {
        LOG_ERR("Connection failed (err %u)", err);
    }
    else
    {
        LOG_INF("Connected");

        if ((!activeConnection) && err == 0)
        {
            activeConnection = bt_conn_ref(connected);
            
            /* Set MTU parameter. NOTE: It's allowed to do it only once during a connection */
            static struct bt_gatt_exchange_params exchange_params;
            exchange_params.func = exchange_func;

            int error = bt_gatt_exchange_mtu(activeConnection, &exchange_params);

#if 0
            bt_le_conn_param param = BT_LE_CONN_PARAM_INIT(
                connectionIntervalMin,
                connectionIntervalMax, 
                connectionLatency, 
                connectionTimeout);
            int error = bt_conn_le_param_update(connected, &param);

            if (error)
            {
                LOG_ERR("Failed to update connection parameters (err = %d)\n", error);
                return;
            }
#endif
        }
    }
}

/**
 * @brief Callback called when client is disconnected. Used to stop BLE notification if no clients are connected.
 * 
 * @param disconn disconnected bluetooth connection
 * @param reason disconnection reason
 */
void OnClientDisconnected(struct bt_conn *disconn, uint8_t reason)
{
    if (activeConnection)
    {
        bt_conn_unref(activeConnection);
        activeConnection = nullptr;

    }
    atomic_set(&Bluetooth::Gatt::ads131m08NotificationsEnable, false);    
    LOG_INF("Disconnected (reason %u)", reason);
}

/**
 * @brief connection status callback
 */
bt_conn_cb connectionCallbacks =
{
    .connected = OnClientConnected,
    .disconnected = OnClientDisconnected,
};

} // namespace

namespace Bluetooth
{

/**
 * @brief Function used to setup BLE Service
 * 
 * @return BLE error code 
 */
int SetupBLE()
{
    //worker.Initialize();

    bt_conn_cb_register(&connectionCallbacks);

    int err = bt_enable(&Gatt::OnBluetoothStarted);
    if (err)
    {
        LOG_INF("enable Bluetooth with status %d", err);
    }
    return err;
}

/**
 * @brief Set the Accelerometer datasource.
 * 
 * @param datasource pointer to datasource with accelerometr data
 */
void SensorNotify(const uint8_t* data, const uint8_t len)
{
    if (atomic_get(&Gatt::ads131m08NotificationsEnable))
    {
        bt_gatt_notify(nullptr, &Gatt::bt832a_svc.attrs[Gatt::CharacteristicSensorData], data, len);
    }
}

} // namespace Bluetooth
```
